OUTPUT_ARCH(arm) ENTRY (cstartup) SECTIONS { _start_of_flash = 0x01000000; _start_of_data = 0x01800000; _end_of_sram = _start_of_data + 4096k; _start_of_header = _start_of_flash + 0x20; _start_of_app = _start_of_flash + 0x50; . = _start_of_flash; .startup : { KEEP(*(sect_startup)) } . = _start_of_header; .header : {	KEEP(*(sect_apphdr)) } . = _start_of_app + 0x100; .text : ALIGN(4) { KEEP(*(.text* .glue_7* .gnu.linkonce.t.*)) KEEP(*(.init)) KEEP(*(.fini)) *crtbegin.o(.ctors) *crtbegin?.o(.ctors) *(EXCLUDE_FILE(*crtend?.o *crtend.o) .ctors) *(SORT(.ctors.*)) *(.ctors) *crtbegin.o(.dtors) *crtbegin?.o(.dtors) *(EXCLUDE_FILE(*crtend?.o *crtend.o) .dtors) *(SORT(.dtors.*)) *(.dtors) KEEP(*(.rodata* .gnu.linkonce.r.*)) KEEP(*(.eh_frame*)) } .ARM.extab : ALIGN(4) {	*(.ARM.extab* .gnu.linkonce.armextab.*) } __exidx_start = .; .ARM.exidx : ALIGN(4) { *(.ARM.exidx* .gnu.linkonce.armexidx.*) } __exidx_end = .; .text_kek : ALIGN(4) { KEEP(*(sect_kek)) } _end_of_app = ALIGN(4); . = _start_of_data; .data : AT (_end_of_app) { KEEP(*(.data*)) . = ALIGN(4); __preinit_array_start = .; KEEP (*(.preinit_array)) __preinit_array_end = .; . = ALIGN(4); __init_array_start = .; KEEP (*(SORT(.init_array.*))) KEEP (*(.init_array)) __init_array_end = .; . = ALIGN(4); __fini_array_start = .; KEEP (*(.fini_array)) KEEP (*(SORT(.fini_array.*))) __fini_array_end = .; _end_of_data = ALIGN(4); } . = _end_of_data; _start_of_bss = .; .bss : { *(.bss*) *(COMMON) } _end = ALIGN(4); _end_of_bss = (_end + 16k); _end_of_flash = _end_of_app + SIZEOF(.data); }